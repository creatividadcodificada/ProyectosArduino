/* AUTOR: CREATIVIDAD CODIFICADA
 *  www.creatividadcodificada.com
 *  NOMBRE DEL PROYECTO: Desplazamiento de texto en una matriz led 8x8 con Arduino
*/

// Mensaje que se mostrara en la matriz led --> CREATIVIDAD CODIFICADA
int mensaje[160] = { 
  0x00, 0x00, 0x00, 0x00, 0x00, 0xFF, 0xFF, 0xC3, 0xC3, 0xC3, 0xC3, 0x00, 0xFF, 0xFF, 0x33, 0x73, 
  0xFF, 0xCF, 0x00, 0xFF, 0xFF, 0xDB, 0xDB, 0xDB, 0xC3, 0x00, 0xFF, 0xFF, 0x33, 0x33, 0xFF, 0xFF, 
  0x00, 0x07, 0x03, 0xFF, 0xFF, 0x03, 0x07, 0x00, 0xC3, 0xC3, 0xFF, 0xFF, 0xC3, 0xC3, 0x00, 0x1F, 
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  0xC3, 0xFF, 0x7E, 0x00, 0xFF, 0xFF, 0x33, 0x33, 0xFF, 0xFF, 0x00, 0x00, 0x00, 0x00, 0x00, 0x00
  };
int _buffer[160];
unsigned long tiempo_1 = 0;
const int row[8] = { // Filas
  9,8,7,6,5,4,3,2
  };
const int col[8] = { // Columnas
  10,11,12,13,A2,A3,A4,A5
  };  
void setup() {
  for(int i = 0; i<8; i++)
  {
    pinMode(row[i],OUTPUT); // Designamos las filas y columnas como salidas
    pinMode(col[i],OUTPUT);
    }
}

void loop() {
  for(int k = 0; k < 8; k++)
  {
    for(int i = 0; i<8; i++)
    {
      digitalWrite(row[i], HIGH);
      for(int j = 0; j < 8; j++)
      {
        int x0 = bitRead(mensaje[i],j); // Usamos la función bitRead() para descomponer nuestros números hexadecimales
        digitalWrite(col[j], !x0);        
        }
      delay(3); //Tiempo del barrido 
      digitalWrite(row[i],LOW);
      digitalWrite(col[i],LOW); 
      }
    }
    mover_letras();
}
void mover_letras()
{
  if(millis() > tiempo_1 + 50) // El desplazamiento del texto se hara cada 50 milisegundos 
  {
    tiempo_1 = millis();
    for(int i = 0; i<160; i++ )
    {
      if(i<159)
      {
        _buffer[i] = mensaje[i+1]; // Llenamos la matriz _buffer
        }
      else
      {
        _buffer[i] = mensaje[1]; // El ultimo dato de la matriz _buffer sera igual al primer dato de la matriz mensaje
        }
          
      }
      for(int i = 0; i<160; i++)
      {
        mensaje[i] = _buffer[i]; // Llenamos la matriz mensaje con los nuevos datos de la matriz _buffer
        }
    }
  }
